## firmware/keyboard/src/application/Kconfig
```kconfig
#===============================================================================
# @brief    Kconfig file.
# Copyright (c) HiSilicon (Shanghai) Technologies Co., Ltd. 2023-2023. All rights reserved.
#===============================================================================

config USER_FIRMWARE_VERSION
    string
    prompt "User Defined Firmware Version"
    default "0.0.0.1"
    help
        This is a user defined firmware version string.
        The string must not exceed 40 characters.

config SYSTEM_CONTROL_ENABLE
    bool
    prompt "Enable system control."
    default n
    help
        This option means support system control config.

if SYSTEM_CONTROL_ENABLE
config POWER_SUPPLY_BY_LDO
    bool
    prompt "Power supply by ldo."
    default n
    depends on SYSTEM_CONTROL_ENABLE
    help
        This option means Power supply by ldo.

config REDUCE_PERP_LS_FREQ
    bool
    prompt "Reduce the frequency of low-speed peripherals."
    default n
    depends on SYSTEM_CONTROL_ENABLE
    help
        This option means reduce the frequency of low-speed peripherals.

config REDUCE_FREQ_DURING_WFI
    bool
    prompt "Reduce frequency during wfi."
    default n
    depends on SYSTEM_CONTROL_ENABLE
    help
        This option means reduce frequency during wfi.

config ULTRA_DEEP_SLEEP_ENABLE
    bool
    prompt "Enable ultra-deep sleep."
    default n
    depends on SYSTEM_CONTROL_ENABLE
    help
        This option means support ultra-deep sleep.

config PM_XO_FAST_START_ENABLE
    bool
    prompt "Enable xo fast start."
    default n
    depends on SYSTEM_CONTROL_ENABLE
    help
        This option means support xo fast start.

config XO_32K_ENABLE
    bool
    prompt "Enable the xo 32k clock."
    default n
    depends on SYSTEM_CONTROL_ENABLE
    help
        This option means enable the xo 32k clock.

config SUPPORT_CLOSE_ULP_WDT_DURING_SLP
    bool
    prompt "Support close ulp-wdt during sleep."
    default n
    depends on SYSTEM_CONTROL_ENABLE
    help
        This option means support close ulp-wdt during sleep.

config DISABLE_GPIO_INTERRUPT_DURING_PAD_SWITCHING
    bool
    prompt "Prevents pin 18/26/27/31 from mis-triggering interrupts during sleep."
    default n
    depends on SYSTEM_CONTROL_ENABLE
    help
        This option means prevents pin 18/26/27/31 from mis-triggering interrupts during sleep.

endif

config SAMPLE_ENABLE
    bool
    prompt "Enable Sample."
    default y
    help
        This option means support Samples.

config KEYBOARD_APP_ENABLE
    bool
    prompt "Enable Keyboard Application."
    default y
    help
        This option means enable keyboard application.

if KEYBOARD_APP_ENABLE
osource "application/bs21e/main_app/Kconfig"
endif
```

## firmware/keyboard/src/drivers/drivers/hal/systick/Kconfig
```kconfig
#===============================================================================
# @brief    Kconfig file.
# Copyright (c) HiSilicon (Shanghai) Technologies Co., Ltd. 2024-2024. All rights reserved.
#===============================================================================

config SYSTICK_WITH_TWO_DATA_REGS
    bool
    prompt "Systick Calculated With Two Data Registers "
    default n
    depends on DRIVER_SUPPORT_SYSTICK
```

## firmware/keyboard/src/middleware/services/srv_tiot_host/Kconfig
```kconfig
#===============================================================================
# @brief    Kconfig file.
# Copyright (c) HiSilicon (Shanghai) Technologies Co., Ltd. 2024-2024. All rights reserved.
#===============================================================================
choice
    prompt "Choose Porting"
    config TIOT_PORTING_AIR_MOUSE
        bool "air_mouse"
    config TIOT_PORTING_BSXX_BRIDGE
        bool "bsxx_bridge"
    config TIOT_PORTING_CAXX_NFC
        bool "caxx_nfc"
    config TIOT_PORTING_WXX_SLP
        bool "wxx_slp"
endchoice
```

## firmware/keyboard/src/middleware/services/srv_tiot_host/tiot_driver/Kconfig
```kconfig
#===============================================================================
# @brief    Kconfig file for kernel.
# Copyright (c) HiSilicon (Shanghai) Technologies Co., Ltd. 2024-2024. All rights reserved.
#===============================================================================

config TIOT_DRIVER
    tristate "tiot driver"
    default n
    help
        Support for tiot drivers.
```

## firmware/keyboard/src/middleware/utils/at/Kconfig
```kconfig
#===============================================================================
# @brief    Kconfig file.
# Copyright (c) HiSilicon (Shanghai) Technologies Co., Ltd. 2022-2023. All rights reserved.
#===============================================================================
config AT_SUPPORT_PLT
    bool
    prompt "platform at command"
    default n
    help
        This option means at support plt.
        
config AT_CMD_MAX_LENGTH
    int
    prompt "The max length of AT command."
    default 128
    help
        This option means the length of at command.

if AT_SUPPORT_PLT
menu "Config AT CFBB"
    comment "Config AT CFBB"
    osource  "middleware/utils/at/at/Kconfig"
endmenu
endif
```

## firmware/keyboard/src/middleware/utils/codec/Kconfig
```kconfig
#===============================================================================
# @brief    Kconfig file.
# Copyright (c) HiSilicon (Shanghai) Technologies Co., Ltd. 2023-2023. All rights reserved.
#===============================================================================
config CODEC_ENABLE_SBC
    bool "SBC"
config CODEC_ENABLE_MSBC
    bool "MSBC"
config CODEC_ENABLE_OPUS
    bool "OPUS"
config CODEC_ENABLE_L2HC
    bool "L2HC"
```

## firmware/keyboard/src/middleware/utils/dfx/Kconfig
```kconfig
#===============================================================================
# @brief    Kconfig file.
# Copyright (c) HiSilicon (Shanghai) Technologies Co., Ltd. 2023-2023. All rights reserved.
#===============================================================================
config DFX_SUPPORT_USERS_PRINT
    bool
    prompt "ENABLE USER TO REGISTER LOG API."
    default y
    depends on MIDDLEWARE_SUPPORT_DFX
config DFX_SUPPORT_PRINT
    bool
    prompt "dfx print with level limit"
    default n
    depends on MIDDLEWARE_SUPPORT_DFX
config CONFIG_ERRCODE_SUPPORT_REPORT
    bool
    prompt "Enable user to register errcode report callback."
    default n
    depends on MIDDLEWARE_SUPPORT_DFX

config PRINT_HSO_LOG_BY_USB_SERIAL
    bool
    prompt "Support print hso log by usb serial."
    default n
    depends on MIDDLEWARE_SUPPORT_DFX
```
